## kernel/Kconfig
```kconfig
mainmenu "EMK Build Configuration"

menu "Build"
    choice
        prompt "Build Mode"
        default BUILD_MODE_DEBUG

    config BUILD_MODE_DEBUG
        bool "Debug"
        help
          Build with debug symbols and no optimizations.

    config BUILD_MODE_RELEASE
        bool "Release"
        help
          Build with optimizations and no debug symbols.

    endchoice
endmenu

menu "Memory"
    choice
        prompt "Kernel Heap Algorithm"
        default KERNEL_HEAP_FF

    config KERNEL_HEAP_FF
        bool "First-Fit"
        help
          Use the First-Fit memory allocation algorithm (ff.c).

    endchoice

    config KERNEL_HEAP_POOL_SIZE
        int "Pool Size (Pages)"
        default 512
        depends on KERNEL_HEAP_FF
        help
          Set the pool size in pages for the First-Fit heap algorithm.
endmenu

menu "Toolchain"
    config CC
        string "C Compiler"
        default "gcc"
        help
          Path to the C compiler to use for building.
endmenu

menu "Extras"
    config ENABLE_FLANTERM
        bool "Enable Flanterm Support"
        help
          Includes support for the Flanterm terminal emulator. Useful for debugging real hardware.
endmenu
```
